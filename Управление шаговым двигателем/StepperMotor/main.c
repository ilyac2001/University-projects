/******************************************************************************
* Основной файл проекта
******************************************************************************/
#include <stm32f072xb.h>
#include "Global.h"
/******************************************************************************
 * Ресурсы
 PC13			 - BTN
 PB4,5,6,7 - IN1,2,3,4 MOTOR
 PA0,1 		 - LED
 PA13,14 - SWDDAT, SWDCLK
******************************************************************************/

/******************************************************************************
 * Переменные
******************************************************************************/
unsigned short counterForMotor, counterForLed;
/******************************************************************************
 * Name:		Моргание светодиода
 * Input:		Нет
 * Return:	Нет
 * Remark:  Используется во время работы двигателя, зависит от тактовой частоты и частоты прерываний, время затухания не зависит от времени работы двигателя 
******************************************************************************/
void LedBlink(){
	if(!(counterForMotor%TIMER_LED_BLINK)){ //каждые 3 секунды выключаем светодиоды
		ledSwitch01();
		counterForLed = NUMBER_INTERRUPTS_PER_SECOND * 0.05; //счётчик затухания (моргания)
	} 
	else if(!(--counterForLed)){ //время затухания сильно меньше, чем 3 секунды => светодиоды надо включить
		ledSwitch01();
		counterForLed = ~counterForLed; //инвертируем это значение, чтобы оно было сильно больше, чем 3 секунды
	}
}
/******************************************************************************
* Прерывание по таймеру TIM16 для шагового двигателя, 400 раз в секунд, частота 100 Гц
******************************************************************************/
void TIM16_IRQHandler(void)
{
	TIM16->SR &= ~TIM_SR_UIF;
	
	if(flag.FlagMotorWork){
		if(!(--counterForMotor)){
			flag.FlagMotorWork = 0;
			counterForMotor = TIMER_MOTOR_WORK;
			ClearMotorRegister();
		} 
		else{
			MotorTakeStep();
			LedBlink();
		}
	} 
	else{
		BtnSurvey();
	}
}
/******************************************************************************
* Системное прерывание
******************************************************************************/
void HardFault_Handler (void)
{
	__NOP();
}
/******************************************************************************
 * Name:		Программная задержка
 * Input:		число микросекунд
 * Return:	Нет
 * Remark:  Не зависит от тактовой частоты 
******************************************************************************/
void Delay (unsigned long mksecond)
{
	unsigned long REG;

	for (REG = 0; REG < ((CLOCK_FREQUENCY/1000000)*mksecond)/6; REG++)
	{
		__NOP();
	}
}

/******************************************************************************
* Инициализация
******************************************************************************/
void init(){
	RCC->AHBENR |= RCC_AHBENR_GPIOAEN | RCC_AHBENR_GPIOCEN | RCC_AHBENR_GPIOBEN; //включение тактирования портов A,B,C
	LedInit();
	BtnInit();
	MotorInit();
	TimerInit();
};
/******************************************************************************
* Основная функция
******************************************************************************/
int main (void)
{
	init();
	ledOn01(); //при старте двигателя лампочки включены
	counterForMotor = TIMER_MOTOR_WORK;
	flag.FlagMotorWork = 0;
	while(1)
	{
		if(btn.btn_short_press){
			flag.FlagMotorWork = 1;
			btn.btn_short_press = 0;
		}
	}
}
